## app/boards/arm/pink_panda/Kconfig
```kconfig
# Pink Panda board configuration

# Copyright (c) 2022 François Gervais
# SPDX-License-Identifier: Apache-2.0

if BOARD_PINK_PANDA

config BOARD_ENABLE_DCDC
	bool "DCDC mode"
	select SOC_DCDC_NRF52X
	default n

config BOARD_ENABLE_DCDC_HV
	bool "High Voltage DCDC converter"
	select SOC_DCDC_NRF52X_HV
	default n

config BOARD_HAS_NRF5_BOOTLOADER
	bool "Board has nRF5 bootloader"
	default n
	help
	  If selected, applications are linked so that they can be loaded by Nordic
	  nRF5 bootloader.

endif # BOARD_PINK_PANDA
```

## west.yml
```yaml
manifest:
  remotes:
    - name: ncs
      url-base: https://github.com/nrfconnect
  projects:
    - name: nrf
      repo-path: sdk-nrf
      remote: ncs
      revision: v2.3.0
      import: true
    - name: zephyr-my-boards
      url: https://github.com/fgervais/zephyr-my-boards
      revision: e5d30531dbe4b099ecc2a0fc6c9dcd5cbdf5c034
      path: myboards
  self:
    path: application
```
